// SPDX-License-Identifier: MIT

#include "sniffer/SlotPlan.hpp"

#include <cstdio>
#include <cstring>

namespace sniff {

const char* roleName(Role r) {
  const std::size_t i = static_cast<std::size_t>(r);
  if (i >= static_cast<std::size_t>(Role::Count)) return "unknown";
  return kRows[i].role;
}

const char* slotFsLabel(Role r) {
  const std::size_t i = static_cast<std::size_t>(r);
  return i < static_cast<std::size_t>(Role::Count) ? kRows[i].fsLabel : "";
}

const char* slotFsType(Role r) {
  const std::size_t i = static_cast<std::size_t>(r);
  return i < static_cast<std::size_t>(Role::Count) ? kRows[i].fsType : "";
}

std::uint8_t maxSlotsForFlash(std::uint32_t flashSizeBytes) {
  // A slot must fit entirely, so this is the number of whole strides between the
  // first slot and the end of flash. Derived rather than declared so that an 8 MB
  // board is handled by the same code as a 16 MB one instead of by whoever
  // remembered to change a constant.
  if (flashSizeBytes <= kFirstSlotOffset) return 0;
  const std::uint32_t free = flashSizeBytes - kFirstSlotOffset;
  const std::uint8_t n = static_cast<std::uint8_t>(free / kSlotStrideBytes);
  return n > kSlotCount ? kSlotCount : n;
}


const char* layoutName(Layout l) {
  switch (l) {
    case Layout::Standalone:
      return "standalone";
    case Layout::Shared:
    default:
      return "shared";
  }
}

std::uint8_t rolesUpTo(Layout layout, std::uint8_t slots, Role* out, std::size_t max) {
  if (out == nullptr) return 0;
  std::size_t n = 0;
  // Bounded by the rows the header defines as well as by `slots` and `max`: asking for
  // ten slots of a five-role layout returns five, not ten copies of the last role.
  for (std::uint8_t i = 0;
       i < slots && n < max && i < static_cast<std::uint8_t>(Role::Count); ++i) {
    out[n] = roleAt(layout, i);
    ++n;
  }
  return static_cast<std::uint8_t>(n);
}

std::string renderSlots(Layout layout, std::uint8_t slots, std::uint32_t flashSizeBytes) {
  char buf[80];
  std::string csv;

  // A header that says where this came from and which framework sits in which slot,
  // because a partition table with no provenance is one somebody will hand-edit.
  std::snprintf(buf, sizeof(buf), "# LoRa sniffer -- Heltec WiFi LoRa 32 V4, %s layout, %u slots.",
                layoutName(layout), static_cast<unsigned>(slots));
  csv += buf;
  csv += "\n#\n";
  csv += "# GENERATED by tools/gen_layouts.py from firmware/include/sniffer/SlotPlan.hpp.\n";
  csv += "# Edit the geometry there, not here; then run:  python tools/gen_layouts.py\n";
  csv += "#\n";
  csv += "# Slot *addresses* are fixed and append-only: slot n lives at the same place\n";
  csv += "# whether this table declares one slot or five, so it can be rewritten in\n";
  csv += "# place to add a framework without ever moving one that already holds\n";
  csv += "# firmware. That is the whole reason growth is safe here.\n";
  csv += "#\n";
  csv += "# Slot *contents* differ per layout. In the shared layout slot n holds the\n";
  csv += "# n-th framework; in the standalone layout slot 0 holds the sniffer and\n";
  csv += "# therefore carries fs_sniffer rather than fs_meshcore. Getting that\n";
  csv += "# pairing wrong is not cosmetic: a MeshCore image flashed into a slot labelled\n";
  csv += "# fs_sniffer would adopt this firmware's settings.\n";
  csv += "#\n";

  for (std::uint8_t i = 0; i < slots; ++i) {
    const Role role = roleAt(layout, i);
    std::snprintf(buf, sizeof(buf), "#   ota_%u / %-13s %-11s", static_cast<unsigned>(i),
                  slotFsLabel(role), roleName(role));
    csv += buf;
    if (i == snifferSlotIn(layout)) {
      csv += "  <-- this firmware";
    }
    csv += "\n";
  }
  if (slots < sharedSlots()) {
    csv += "#\n";
    for (std::uint8_t i = slots; i < sharedSlots(); ++i) {
      std::snprintf(buf, sizeof(buf), "#   ota_%u                      reserved, %s not flashed here",
                    static_cast<unsigned>(i), slotFsLabel(static_cast<Role>(i)));
      csv += buf;
      csv += "\n";
    }
  }
  csv += "#\n";
  csv += "# Meshtastic mounts LittleFS and MeshCore mounts SPIFFS. Handing either side\n";
  csv += "# the other's filesystem type makes it format the wrong one on boot and lose\n";
  csv += "# the settings of the other side of the pair, with no error anywhere.\n";
  csv += "#\n";
  csv += "# Every app offset is 64KB aligned. The bootloader refuses a misaligned app\n";
  csv += "# partition and reports nothing, so a board with one simply looks dead.\n";
  csv += "#\n";
  csv += "# Validate with: python tools/gate.py\n\n";

  // The fixed region below the slots. Appended line by line rather than as one
  // snprintf of a multi-line literal: snprintf reports the length it *would* have
  // written, so appending that many bytes from a buffer it truncated reads past the
  // end of the buffer. That is a real over-read, and it is invisible until the table
  // comes out subtly wrong.
  auto row = [&csv](const char* text) {
    csv += text;
    csv += "\n";
  };
  // The bootloader and the partition table are NOT rows in this table.
  //
  // The bootloader is flashed at 0x0 out of band, and the partition table occupies the
  // single 4 KB sector at 0x8000 whether or not a row claims it. Listing the table there
  // is not redundant, it is fatal: the chip's own generator reads a row at 0x8000 as
  // *overlapping* the table's extent and refuses the whole file with "first partition
  // offset 0x0 overlaps end of partition table 0x9000". Every environment failed to
  // build until these two lines went.
  //
  // `otadata`'s *subtype* is `ota`. `otadata` is a fine partition name and not a subtype
  // keyword at all; ESP-IDF answers "Value 'otadata' is not valid" for it.
  row("# 0x0000  bootloader, flashed out of band and not described here");
  row("# 0x8000  this table, one 4 KB sector, not described here either");
  row("# 0x9000  first partition below");
  row("");
  row("otadata        , data , ota      , 0x14000, 0x2000,");
  row("nvs            , data , nvs      , 0x16000, 0xA000,");
  row("coredump       , data , coredump , 0x20000, 0x10000,");
  csv += "\n";

  for (std::uint8_t i = 0; i < slots; ++i) {
    const Role role = roleAt(layout, i);
    const std::uint32_t appOff = slotOffset(i);

    if (appOff % kAppAlignment != 0) {
      // Cannot happen with this geometry, and if it ever does the CSV would be
      // rejected by the bootloader with no message at all.
      continue;
    }

    std::snprintf(buf, sizeof(buf), "ota_%u          , app  , ota_%u    , 0x%X, 0x%X,",
                  static_cast<unsigned>(i), static_cast<unsigned>(i),
                  static_cast<unsigned>(appOff), static_cast<unsigned>(kSlotAppBytes));
    csv += buf;
    csv += "\n";

    std::snprintf(buf, sizeof(buf), "%-14s , data , %-9s, 0x%X, 0x%X,", slotFsLabel(role),
                  slotFsType(role), static_cast<unsigned>(appOff + kSlotAppBytes),
                  static_cast<unsigned>(kSlotFsBytes));
    csv += buf;
    csv += "\n";
  }

  const std::uint32_t used =
      slots > 0 ? slotFsOffset(static_cast<std::uint8_t>(slots - 1)) + kSlotFsBytes
                : kFirstSlotOffset;
  if (flashSizeBytes > used) {
    csv += "\n";
    std::snprintf(buf, sizeof(buf), "# %u bytes free after slot %u",
                  static_cast<unsigned>(flashSizeBytes - used),
                  static_cast<unsigned>(slots == 0 ? 0 : slots - 1));
    csv += buf;
    csv += "\n";
  }
  return csv;
}


const char* layoutStatusName(LayoutStatus s) {
  switch (s) {
    case LayoutStatus::Ok:
      return "ok";
    case LayoutStatus::OverrunsFlash:
      return "overruns-flash";
    case LayoutStatus::MisalignedApp:
      return "misaligned-app";
    case LayoutStatus::SnifferSlotMissing:
      return "sniffer-slot-missing";
    case LayoutStatus::SharedFilesystem:
      return "shared-filesystem";
    case LayoutStatus::SnifferTooSmall:
      return "sniffer-too-small";
    case LayoutStatus::WrongFilesystemForSlot:
      return "wrong-filesystem-for-slot";
    default:
      return "unknown";
  }
}

LayoutReport validateForSniffer(Layout layout, std::uint32_t flashSizeBytes) {
  return validateSlots(layout, slotsIn(layout), snifferSlotIn(layout), flashSizeBytes);
}

LayoutReport validateSlots(Layout layout, std::uint8_t slots, std::uint8_t snifferSlot,
                           std::uint32_t flashSizeBytes) {
  LayoutReport rep;
  rep.slots = slots;
  const std::uint8_t capacity = maxSlotsForFlash(flashSizeBytes);
  rep.freeBytes = (slots <= capacity && slots > 0)
                      ? flashSizeBytes - slotFsOffset(static_cast<std::uint8_t>(slots - 1)) -
                            kSlotFsBytes
                      : 0u;

  if (slots == 0) {
    rep.status = LayoutStatus::SnifferSlotMissing;
    std::snprintf(rep.detail, sizeof(rep.detail),
                  "this layout declares no slots, so there is nowhere to put the sniffer");
    return rep;
  }

  if (slots > capacity) {
    rep.status = LayoutStatus::OverrunsFlash;
    std::snprintf(rep.detail, sizeof(rep.detail),
                  "%u slots do not fit; this flash holds %u at the fixed stride",
                  static_cast<unsigned>(slots), static_cast<unsigned>(capacity));
    return rep;
  }

  for (std::uint8_t i = 0; i < slots; ++i) {
    const std::uint32_t appOff = slotOffset(i);
    if (appOff % kAppAlignment != 0) {
      rep.status = LayoutStatus::MisalignedApp;
      std::snprintf(rep.detail, sizeof(rep.detail),
                    "ota_%u is not 64KB aligned; the bootloader refuses this and the board "
                    "looks simply dead",
                    static_cast<unsigned>(i));
      return rep;
    }
    if (appOff + kSlotAppBytes + kSlotFsBytes > flashSizeBytes) {
      rep.status = LayoutStatus::OverrunsFlash;
      std::snprintf(rep.detail, sizeof(rep.detail), "ota_%u runs past the end of flash",
                    static_cast<unsigned>(i));
      return rep;
    }
  }

  // The sniffer has to actually be in this layout. In the shared one that means slot
  // two, and the refusal explains *why* it is third rather than just stating the fact.
  if (snifferSlot >= slots) {
    rep.status = LayoutStatus::SnifferSlotMissing;
    std::snprintf(rep.detail, sizeof(rep.detail),
                  "the sniffer lives in slot %u and this layout has %u. MeshCore first, then "
                  "Meshtastic, then the sniffer -- it is offered third on purpose, because the "
                  "first slot is what a virgin board comes up as, and that should be a working "
                  "mesh node rather than a logger somebody forgot to turn off",
                  static_cast<unsigned>(snifferSlot), static_cast<unsigned>(slots));
    return rep;
  }

  // The pairing. Distinct offsets are already guaranteed by the geometry, so re-testing
  // that would be decoration; what is *not* covered is which filesystem belongs to
  // which slot. Two frameworks sharing one is how a repeater's channel keys get
  // reformatted by something an operator ran for five minutes.
  const char* wantLabel = slotFsLabel(Role::Sniffer);
  for (std::uint8_t i = 0; i < slots; ++i) {
    if (i == snifferSlot) continue;
    const Role other = roleAt(layout, i);
    if (std::strcmp(slotFsLabel(other), wantLabel) != 0) continue;
    rep.status = LayoutStatus::SharedFilesystem;
    std::snprintf(rep.detail, sizeof(rep.detail),
                  "ota_%u (%s) shares the sniffer's filesystem label %s. A tool that boots "
                  "into a slot it shares with a mesh stack has nowhere to keep its own "
                  "settings except inside somebody else's",
                  static_cast<unsigned>(i), roleName(other), wantLabel);
    return rep;
  }

  // And the check that catches the bug this function was rewritten for: a layout whose
  // sniffer slot is paired with somebody else's filesystem label. The standalone table
  // generated from the canonical slot order did exactly that, and the overlap and
  // alignment checks above were all perfectly happy with it.
  if (std::strcmp(slotFsLabel(roleAt(layout, snifferSlot)), wantLabel) != 0) {
    rep.status = LayoutStatus::WrongFilesystemForSlot;
    std::snprintf(rep.detail, sizeof(rep.detail),
                  "the sniffer's slot %u is paired with %s, not %s. A MeshCore image flashed "
                  "into that slot would adopt this firmware's settings",
                  static_cast<unsigned>(snifferSlot), slotFsLabel(roleAt(layout, snifferSlot)),
                  wantLabel);
    return rep;
  }

  // 2 MB of app. A sniffer with four decoders, a JSON writer and a radio stack is
  // comfortably inside that, and the check exists so that shrinking the slot to find
  // the limit says why rather than failing at link time on a board.
  if (kSlotAppBytes < 0x100000u) {
    rep.status = LayoutStatus::SnifferTooSmall;
    std::snprintf(rep.detail, sizeof(rep.detail),
                  "the sniffer needs at least 1MB of app and this slot has %uKB",
                  static_cast<unsigned>(kSlotAppBytes / 1024u));
    return rep;
  }

  rep.status = LayoutStatus::Ok;
  rep.detail[0] = '\0';
  return rep;
}

}  // namespace sniff
